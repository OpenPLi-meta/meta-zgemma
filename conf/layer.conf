## conf/layer.conf
```bitbake
# We have a conf and classes directory, append to BBPATH
BBPATH .= ":${LAYERDIR}"

BBFILES += "${LAYERDIR}/recipes-*/*.bb ${LAYERDIR}/recipes-*/*/*.bb ${LAYERDIR}/recipes-*/*/*.bbappend"

BSP-BASE-ZGEMMA := '${@os.path.normpath("${LAYERDIR}/")}'
```

## conf/machine/h10.conf
```bitbake
#@TYPE: Machine
#@NAME: h10
#@DESCRIPTION: Machine configuration for the h10

SOC_FAMILY = "hisi3798mv200"
CHIPSET = "Hi3798Mv200"
HICHIPSET = "3798mv200"

BRAND_OEM = "airdigital"
MACHINE_BRAND = "Zgemma"
MACHINE_NAME = "H10"

KERNEL_FILE = "uImage"
ROOTFS_FILE = "rootfs.tar.bz2"
MTD_BLACK  = "mmcblk0"
MTD_KERNEL = "mmcblk0p19"
MTD_ROOTFS = "mmcblk0p23"
MTD_BOOTFS = "mmcblk0p4"

MACHINE_FEATURES += "hdmicec textlcd 7segment blindscan-dvbs hisil hisil-3798mv200 himedia mali transcoding emmc skins1080 no-subssupport dvb-c bluetooth wol ciplus-helper fastboot mountboot HDMI"
OPENPLI_FEATURES += " qtplugins kodi"
DISTRO_FEATURES_remove = "x11 wayland directfb"

# TARGET_ARCH = "aarch64"
# DEFAULTTUNE = "aarch64"
TARGET_ARCH = "arm"
DEFAULTTUNE = "cortexa15hf-neon-vfpv4"

IMAGE_CLASSES += " zgemma-fastboot8gb_image"
IMAGE_FSTYPES += " zgemmafastboot8gb tar"
CMDLINE ?= "console=ttyAMA0,115200n8"

RCTYPE = "28"

require conf/machine/include/zgemma-hisil-3798mv200.inc
```

## conf/machine/h10se.conf
```bitbake
#@TYPE: Machine
#@NAME: h10se
#@DESCRIPTION: Machine configuration for the h10se

SOC_FAMILY = "hisi3798mv200"
CHIPSET = "Hi3798Mv200"
HICHIPSET = "3798mv200"

BRAND_OEM = "airdigital"
MACHINE_BRAND = "Zgemma"
MACHINE_NAME = "H10 SE"

KERNEL_FILE = "uImage"
ROOTFS_FILE = "rootfs.tar.bz2"
MTD_BLACK  = "mmcblk0"
MTD_KERNEL = "mmcblk0p19"
MTD_ROOTFS = "mmcblk0p23"
MTD_BOOTFS = "mmcblk0p4"

MACHINE_FEATURES += " hdmicec ci 7segment blindscan textlcd hisil mali transcoding emmc skins1080 transcoding multitranscoding himedia no-subssupport dvb-c blindscan-dvbs blindscan bluetooth wol ciplus-helper fastboot mountboot HDMI"
OPENPLI_FEATURES += " qtplugins kodi"
DISTRO_FEATURES:remove = "x11 wayland directfb"

# TARGET_ARCH = "aarch64"
# DEFAULTTUNE = "aarch64"
TARGET_ARCH = "arm"
DEFAULTTUNE = "cortexa15hf-neon-vfpv4"

IMAGE_CLASSES += " zgemma-fastboot8gb_image"
IMAGE_FSTYPES += " zgemmafastboot8gb tar"
CMDLINE ?= "console=ttyAMA0,115200n8"

RCTYPE = "28"

require conf/machine/include/zgemma-hisil-3798mv200.inc
```

## conf/machine/h11.conf
```bitbake
#@TYPE: Machine
#@NAME: h11
#@DESCRIPTION: Machine configuration for the h11

SOC_FAMILY = "hisi3798mv310"
CHIPSET = "Hi3798Mv310"
HICHIPSET = "3798mv310"

BRAND_OEM = "airdigital"
MACHINE_BRAND = "Zgemma"
MACHINE_NAME = "H11"

KERNEL_FILE = "uImage"
ROOTFS_FILE = "rootfs.tar.bz2"
MTD_BLACK  = "mmcblk0"
MTD_KERNEL = "mmcblk0p19"
MTD_ROOTFS = "mmcblk0p23"
MTD_BOOTFS = "mmcblk0p4"

MACHINE_FEATURES += " hdmicec hisil hisil-3798mv310 mali transcoding skins1080 himedia no-subssupport blindscan dvb-c wol bluetooth fastboot mountboot HDMI"
OPENPLI_FEATURES += " qtplugins kodi"
DISTRO_FEATURES_remove = "x11 wayland directfb"

# TARGET_ARCH = "aarch64"
# DEFAULTTUNE = "aarch64"
TARGET_ARCH = "arm"
DEFAULTTUNE = "cortexa15hf-neon-vfpv4"

IMAGE_CLASSES += " zgemma-fastboot8gb_image"
IMAGE_FSTYPES += " zgemmafastboot8gb tar"
CMDLINE ?= "console=ttyAMA0,115200n8"

RCTYPE = "28"

require conf/machine/include/zgemma-hisil-3798mv310.inc
```

## conf/machine/h17.conf
```bitbake
#@TYPE: Machine
#@NAME: h17
#@DESCRIPTION: Machine configuration for the h17

SOC_FAMILY = "bcm7251s"
CHIPSET = "bcm7251s"

BRAND_OEM = "airdigital"
MACHINE_BRAND = "Zgemma"
MACHINE_NAME = "H17"

KERNEL_FILE = "kernel.bin"
ROOTFS_FILE = "rootfs.tar.bz2"
MTD_BLACK = "mmcblk0"
MTD_BOOTFS = "mmcblk0p1"
MTD_KERNEL = "mmcblk0p2"
MTD_ROOTFS = "mmcblk0p3"

MACHINE_FEATURES += " ci textlcd dvb-c skins1080 qteglfs v3d-cortexa15 emmc v3d-nxpl"
OPENPLI_FEATURES += " qtplugins kodi"
DISTRO_FEATURES_remove = "x11 wayland directfb"

TARGET_ARCH = "arm"
DEFAULTTUNE = "cortexa15hf-neon-vfpv4"

IMAGE_CLASSES += "zgemma-emmc_image_multiboot"
IMAGE_FSTYPES += "zgemmc tar"
IMAGE_ROOTFS_SIZE ?= "294912"

RCTYPE = "21"

require conf/machine/include/zgemma-cortex-a15.inc

BBMASK = "meta-vuplus/recipes-graphics/"
BBMASK += "meta-vuplus/recipes-webkit/"
```

## conf/machine/h3.conf
```bitbake
#@TYPE: Machine
#@NAME: h3
#@DESCRIPTION: Machine configuration for h3

SOC_FAMILY = "bcm7362"
CHIPSET = "bcm7362"

BRAND_OEM = "airdigital"
MACHINE_BRAND = "Zgemma"
MACHINE_NAME = "H3"

KERNEL_FILE = "kernel.bin"
ROOTFS_FILE = "rootfs.bin"
MTD_KERNEL = "mtd1"
MTD_ROOTFS = "mtd2"

MACHINE_FEATURES += " HDMI RCA textlcd 7segment dvb-c videoenhancement skins1080"
DISTRO_FEATURES_remove = "x11 wayland directfb"

MKUBIFS_ARGS = "-m 2048 -e 126976 -c 8192"
UBINIZE_ARGS = "-m 2048 -p 128KiB"

RCTYPE = "21"

FORCE = "no"

require conf/machine/include/zgemma-mipsel.inc
```

## conf/machine/h4.conf
```bitbake
#@TYPE: Machine
#@NAME: h4
#@DESCRIPTION: Machine configuration for h4

SOC_FAMILY = "bcm7583"
CHIPSET = "bcm7583"

BRAND_OEM = "airdigital"
MACHINE_BRAND = "Zgemma"
MACHINE_NAME = "H4"

KERNEL_FILE = "kernel.bin"
ROOTFS_FILE = "rootfs.bin"
MTD_KERNEL = "mtd1"
MTD_ROOTFS = "mtd2"

MACHINE_FEATURES += " HDMI RCA textlcd 7segment dvb-c videoenhancement skins1080"
DISTRO_FEATURES_remove = "x11 wayland directfb"

MKUBIFS_ARGS = "-m 2048 -e 126976 -c 8192"
UBINIZE_ARGS = "-m 2048 -p 128KiB"

RCTYPE = "21"

FORCE = "no"

require conf/machine/include/zgemma-mipsel.inc
```

## conf/machine/h5.conf
```bitbake
#@TYPE: Machine
#@NAME: h5
#@DESCRIPTION: Machine configuration for h5

SOC_FAMILY = "bcm73625"
CHIPSET = "bcm73625"

BRAND_OEM = "airdigital"
MACHINE_BRAND = "Zgemma"
MACHINE_NAME = "H5"

KERNEL_FILE = "kernel.bin"
ROOTFS_FILE = "rootfs.bin"
MTD_KERNEL = "mtd1"
MTD_ROOTFS = "mtd2"

MACHINE_FEATURES += " HDMI RCA h265 textlcd 7segment dvb-c videoenhancement skins1080"
DISTRO_FEATURES:remove = "x11 wayland directfb"

MKUBIFS_ARGS = "-m 2048 -e 126976 -c 8192"
UBINIZE_ARGS = "-m 2048 -p 128KiB"

RCTYPE = "21"

FORCE = "no"

require conf/machine/include/zgemma-mipsel.inc
```

## conf/machine/h6.conf
```bitbake
#@TYPE: Machine
#@NAME: h6
#@DESCRIPTION: Machine configuration for h6

SOC_FAMILY = "bcm73625"
CHIPSET = "bcm73625"

BRAND_OEM = "airdigital"
MACHINE_BRAND = "Zgemma"
MACHINE_NAME = "H6"

KERNEL_FILE = "kernel.bin"
ROOTFS_FILE = "rootfs.bin"
MTD_KERNEL = "mtd1"
MTD_ROOTFS = "mtd2"

MACHINE_FEATURES += " HDMI RCA ci h265 textlcd 7segment dvb-c videoenhancement skins1080"
DISTRO_FEATURES:remove = "x11 wayland directfb"

MKUBIFS_ARGS = "-m 2048 -e 126976 -c 8192"
UBINIZE_ARGS = "-m 2048 -p 128KiB"

RCTYPE = "21"

FORCE = "no"

require conf/machine/include/zgemma-mipsel.inc
```

## conf/machine/h9combo.conf
```bitbake
#@TYPE: Machine
#@NAME: h9combo
#@DESCRIPTION: Machine configuration for the h9combo

SOC_FAMILY = "hisi3798mv200"
CHIPSET = "Hi3798Mv200"
HICHIPSET = "3798mv200"

BRAND_OEM = "airdigital"
MACHINE_BRAND = "Zgemma"
MACHINE_NAME = "H9 COMBO"

KERNEL_FILE = "uImage"
ROOTFS_FILE = "rootfs.tar.bz2"
MTD_BLACK  = "mmcblk0"
MTD_KERNEL = "mmcblk0p19"
MTD_ROOTFS = "mmcblk0p23"
MTD_BOOTFS = "mmcblk0p4"

MACHINE_FEATURES += "hdmicec ci textlcd 7segment hisil hisil-3798mv200 mali transcoding emmc skins1080 himedia no-subssupport blindscan-dvb-s dvb-c wol ciplus-helper fastboot mountboot HDMI"
OPENPLI_FEATURES += " qtplugins kodi"
DISTRO_FEATURES_remove = "x11 wayland directfb"

# TARGET_ARCH = "aarch64"
# DEFAULTTUNE = "aarch64"
TARGET_ARCH = "arm"
DEFAULTTUNE = "cortexa15hf-neon-vfpv4"

IMAGE_CLASSES += " zgemma-fastboot8gb_image"
IMAGE_FSTYPES += " zgemmafastboot8gb tar"
CMDLINE ?= "console=ttyAMA0,115200n8"

RCTYPE = "28"

require conf/machine/include/zgemma-hisil-3798mv200.inc
```

## conf/machine/h9combose.conf
```bitbake
#@TYPE: Machine
#@NAME: h9combose
#@DESCRIPTION: Machine configuration for the h9combose

SOC_FAMILY = "hisi3798mv200"
CHIPSET = "Hi3798Mv200"
HICHIPSET = "3798mv200"

BRAND_OEM = "airdigital"
MACHINE_BRAND = "Zgemma"
MACHINE_NAME = "H9 COMBO SE"

KERNEL_FILE = "uImage"
ROOTFS_FILE = "rootfs.tar.bz2"
MTD_BLACK  = "mmcblk0"
MTD_KERNEL = "mmcblk0p19"
MTD_ROOTFS = "mmcblk0p23"
MTD_BOOTFS = "mmcblk0p4"

MACHINE_FEATURES += "hdmicec ci textlcd 7segment blindscan-dvbs hisil hisil-3798mv200 mali emmc skins1080 himedia transcoding no-subssupport dvb-c wol ciplus-helper fastboot mountboot HDMI"
OPENPLI_FEATURES += " qtplugins kodi"
DISTRO_FEATURES:remove = "x11 wayland directfb"

# TARGET_ARCH = "aarch64"
# DEFAULTTUNE = "aarch64"
TARGET_ARCH = "arm"
DEFAULTTUNE = "cortexa15hf-neon-vfpv4"

IMAGE_CLASSES += " zgemma-fastboot8gb_image"
IMAGE_FSTYPES += " zgemmafastboot8gb tar"
CMDLINE ?= "console=ttyAMA0,115200n8"

RCTYPE = "28"

require conf/machine/include/zgemma-hisil-3798mv200.inc
```

## conf/machine/hzero.conf
```bitbake
#@TYPE: Machine
#@NAME: hzero
#@DESCRIPTION: Machine configuration for the hzero

SOC_FAMILY = "hisi3716mv430"
CHIPSET = "Hi3716Mv430"
HICHIPSET = "3716mv430"

BRAND_OEM = "airdigital"
MACHINE_BRAND = "Zgemma"
MACHINE_NAME = "Hzero S"

MTD_KERNEL = "mtd9"
MTD_ROOTFS = "mtd10"
KERNEL_FILE = "uImage"
ROOTFS_FILE = "rootfs.ubi"

MACHINE_FEATURES += " no-opengl ci wol hisil hisil-3716mv430 mali emmc skins1080 ciplus-helper no-subssupport fastboot HDMI"
OPENPLI_FEATURES += " qtplugins"
DISTRO_FEATURES:remove = "x11 wayland directfb"

# TARGET_ARCH = "aarch64"
# DEFAULTTUNE = "aarch64"
TARGET_ARCH = "arm"
DEFAULTTUNE = "cortexa7thf"
# DEFAULTTUNE = "cortexa9thf-vfpv3"

IMAGE_CLASSES += " zgemma-ubi_image"
IMAGE_FSTYPES += " ubi zgemmaubi"
MKUBIFS_ARGS = "-m 4096 -e 253952 -c 2048"
UBINIZE_ARGS = "-m 4096 -p 256KiB -s 4096"
UBI_VOLNAME = "rootfs"
CMDLINE ?= "console=ttyAMA0,115200n8"

RCTYPE = "25"

FORCE = "no"

require conf/machine/include/zgemma-hisil-3716mv430.inc
```

## conf/machine/lc.conf
```bitbake
#@TYPE: Machine
#@NAME: lc
#@DESCRIPTION: Machine configuration for lc

SOC_FAMILY = "bcm7581"
CHIPSET = "bcm7581"

BRAND_OEM = "airdigital"
MACHINE_BRAND = "Zgemma"
MACHINE_NAME = "Star LC"

KERNEL_FILE = "kernel.bin"
ROOTFS_FILE = "rootfs.bin"
MTD_KERNEL = "mtd1"
MTD_ROOTFS = "mtd2"

MACHINE_FEATURES += " HDMI RCA skins1080 smallflash textlcd 7segment dvb-c videoenhancement dvb-c"
DISTRO_FEATURES:remove = "x11 wayland directfb"

MKUBIFS_ARGS = "-m 2048 -e 126976 -c 4096"
UBINIZE_ARGS = "-m 2048 -p 128KiB"

DEFAULTTUNE = "mips32el-nf"

RCTYPE = "20"

FORCE = "no"

require conf/machine/include/zgemma-mipsel.inc
```

## conf/machine/sh1.conf
```bitbake
#@TYPE: Machine
#@NAME: sh1
#@DESCRIPTION: Machine configuration for sh1, s2s

SOC_FAMILY = "bcm7358"
CHIPSET = "bcm7358"

BRAND_OEM = "airdigital"
MACHINE_BRAND = "Zgemma"
MACHINE_NAME = "Star H1"

KERNEL_FILE = "kernel.bin"
ROOTFS_FILE = "rootfs.bin"
MTD_KERNEL = "mtd1"
MTD_ROOTFS = "mtd2"

MACHINE_FEATURES += " HDMI RCA textlcd 7segment smallflash dvb-c videoenhancement"
DISTRO_FEATURES_remove = "x11 wayland directfb"

MKUBIFS_ARGS = "-m 2048 -e 126976 -c 4096"
UBINIZE_ARGS = "-m 2048 -p 128KiB"

DEFAULTTUNE = "mips32el-nf"

RCTYPE = "20"

FORCE = "no"

require conf/machine/include/zgemma-mipsel.inc
```
